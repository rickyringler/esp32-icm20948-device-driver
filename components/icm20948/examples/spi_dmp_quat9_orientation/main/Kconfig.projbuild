## components/icm20948/examples/spi_dmp_quat9_orientation/main/Kconfig.projbuild
```kconfig
menu "ICM-20948 Example"

    config SPI_MASTER_MOSI
        int "MOSI GPIO Num"
        default 9
        help
            GPIO number for SPI MOSI data line.

    config SPI_MASTER_MISO
        int "MISO GPIO Num"
        default 5
        help
            GPIO number for SPI MISO data line.

    config SPI_MASTER_SCK
        int "Clock GPIO Num"
        default 3
        help
            GPIO number for the SPI clock line 

    config SPI_MASTER_CS
        int "Chip Select GPIO Num"
        default 18
        help
            GPIO number for the SPI chip select line
        
endmenu
```
